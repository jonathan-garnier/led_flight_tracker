## sdkconfig.defaults
```kconfig
CONFIG_ESP32_HUB75_USE_GFX=y
CONFIG_FREERTOS_HZ=1000
CONFIG_ESPTOOLPY_FLASHSIZE_16MB=y
CONFIG_ESPTOOLPY_FLASHSIZE="16MB"
CONFIG_PARTITION_TABLE_SINGLE_APP_LARGE=y
CONFIG_ESP_MAIN_TASK_STACK_SIZE=8192
CONFIG_PERIPH_CTRL_FUNC_IN_IRAM=y
CONFIG_HTTPD_MAX_REQ_HDR_LEN=1024
```
